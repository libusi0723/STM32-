#include "wave.h"
#include <stdint.h>
#include "stm32f10x.h"
#include <stdio.h>
#include <math.h>
#include "dac.h"


#define TABLE_SIZE (sizeof(sine_table)/sizeof(sine_table[0]))
u8 wave_type = 0;      // 0:正弦 1:方波 2:三角波
u16 freq = 1000;       // 输出频率
u8 amplitude = 100;    // 幅值百分比 0~100

const u16 sine_table[] =
{
2048,2098,2148,2198,2248,2298,2348,2397,
2447,2496,2545,2594,2642,2690,2737,2784,
2831,2877,2922,2967,3011,3055,3098,3140,
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1855,1898,1941,1985,2029,2048
};


/*u16 sine_table[TABLE_SIZE];
void Sine_Table_Init(void)
{
    u16 i;

    for(i = 0; i < TABLE_SIZE; i++)
    {
        sine_table[i] =
        (u16)(
            2048 +
            2047 *
            sin(2 * 3.1415926 * TABLE_SIZE / 256)
        );
    }
}
*/

//====================================================
// 波形更新
//====================================================
void Wave_Update(void)
{
    u16 value = 2048;
    u16 peak;
    static u16 index = 0;

    peak = (u16)(2047UL * amplitude / 100);
    
    //------------------------------------------------
    // 正弦波
    //------------------------------------------------
    if(wave_type == 0)
    {
       value = 2048 + ((sine_table[index] - 2048) * amplitude / 100);
    } 
     
    //------------------------------------------------
    // 方波
    //------------------------------------------------
    else if(wave_type == 1)
    {
        if(index < TABLE_SIZE / 2)
            value = 2048 + peak;
        else
            value = 2048 - peak;
    }

    //------------------------------------------------
    // 三角波
    //------------------------------------------------
    else if(wave_type == 2)
    {
        if(index < 256/ 2)
        {
            value = (2048 - peak) +
                    (u32)(2 * peak) * index / (TABLE_SIZE / 2);
        }
        else
        {
            value = (2048 + peak) -
                    (u32)(2 * peak) *
                    (index - TABLE_SIZE / 2) /
                    (TABLE_SIZE / 2);
        }
    }

    //------------------------------------------------
    // 限幅保护
    //------------------------------------------------
    if(value > 4095)
        value = 4095;

    DAC_SetValue(value);

    //------------------------------------------------
    // 更新索引
    //------------------------------------------------
    index++;

    if(index >= TABLE_SIZE)
        index = 0;
}


//====================================================
// TIM2频率更新
//====================================================
void TIM2_Freq_Update(void)
{
    u16 psc = 71;
    u32 temp;

    temp = 72000000 / (psc + 1);

    temp = temp / (freq * TABLE_SIZE);

    if(temp > 0)
        temp--;

    if(temp > 65535)
        temp = 65535;

    TIM2->PSC = psc;
    TIM2->ARR = (u16)temp;
    TIM2->CNT = 0;
}